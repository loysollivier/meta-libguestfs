## conf/layer.conf
```bitbake
# We have a conf and classes directory, add to BBPATH
BBPATH .= ":${LAYERDIR}"

# We have recipes-* directories, add to BBFILES
BBFILES += "${LAYERDIR}/*.bb \
	${LAYERDIR}/*.bbappend"

BBFILE_COLLECTIONS += "libguestfs"
BBFILE_PATTERN_libguestfs = "^${LAYERDIR}/"
BBFILE_PRIORITY_libguestfs = "6"
```
